## arch/risc-v/src/esp32p4/Kconfig
```kconfig
#
# For a description of the syntax of this configuration file,
# see the file kconfig-language.txt in the NuttX tools repository.
#

if ARCH_CHIP_ESP32P4

source "arch/risc-v/src/common/espressif/Kconfig"

config ESP32P4_SELECTS_REV_LESS_V3
	bool "Select ESP32-P4 revisions <3.0 (No >=3.x Support)"
	default n
	---help---
		Select this option to support ESP32-P4 revisions 0.x and 1.x.
		Revisions higher than 3.0 (included) and revisions less than 3.0
		have huge hardware difference.
		Revisions higher than 3.0 (included) is not compatible with 0.x and 1.x.

choice ESP32P4_REV_MIN
	prompt "Minimum Supported ESP32-P4 Revision"
	default ESP32P4_REV_MIN_1
	---help---
		Required minimum chip revision. ESP-IDF will check for it and
		reject to boot if the chip revision fails the check.
		This ensures the chip used will have some modifications (features, or bugfixes).

		The complied binary will only support chips above this revision,
		this will also help to reduce binary size.

config ESP32P4_REV_MIN_0
	depends on ESP32P4_SELECTS_REV_LESS_V3
	bool "Rev v0.0"

config ESP32P4_REV_MIN_1
	depends on ESP32P4_SELECTS_REV_LESS_V3
	bool "Rev v0.1"

config ESP32P4_REV_MIN_100
	depends on ESP32P4_SELECTS_REV_LESS_V3
	bool "Rev v1.0"

config ESP32P4_REV_MIN_300
	bool "Rev v3.0"
	depends on !ESP32P4_SELECTS_REV_LESS_V3

endchoice # ESP32P4_REV_MIN

config ESP32P4_REV_MIN_FULL
	int
	default 0 if ESP32P4_REV_MIN_0
	default 1 if ESP32P4_REV_MIN_1
	default 100 if ESP32P4_REV_MIN_100
	default 300 if ESP32P4_REV_MIN_300

config ESP_REV_MIN_FULL
	int
	default ESP32P4_REV_MIN_FULL

config ESP32P4_REV_MAX_FULL
	int
	default 399 if !ESP32P4_SELECTS_REV_LESS_V3
	default 199 if ESP32P4_SELECTS_REV_LESS_V3

# keep in sync the "Maximum Supported Revision" description with this value

config ESP_REV_MAX_FULL
	int
	default ESP32P4_REV_MAX_FULL

config ESP_EFUSE_BLOCK_REV_MIN_FULL
	int "Minimum Supported ESP32-P4 eFuse Block Revision"
	default 0
	---help---
		Required minimum eFuse Block revision. ESP-IDF will check it at the 2nd bootloader stage
		whether the current image can work correctly for this eFuse Block revision.
		So that to avoid running an incompatible image on a SoC that contains breaking change in the eFuse Block.
		If you want to update this value to run the image that not compatible with the current eFuse Block revision,
		please contact to Espressif's business team for details:
		https://www.espressif.com.cn/en/contact-us/sales-questions

config ESP_EFUSE_BLOCK_REV_MAX_FULL
	int
	default 199
	comment "Maximum Supported ESP32-P4 eFuse Block Revision (eFuse Block Rev v0.99)"

# The revision in the comment must correspond to the default value of ESP_EFUSE_BLOCK_REV_MAX_FULL

menu "PSRAM Configuration"
	depends on ARCH_CHIP_ESP32P4

config ESP32P4_SPIRAM
	bool "SPI RAM (PSRAM) Support"
	default n
	select ARCH_HAVE_HEAP2
	---help---
		Enable support for an external SPI RAM chip, connected in
		parallel with the main SPI flash chip.

if ESP32P4_SPIRAM

choice ESP32P4_SPIRAM_MODE
	prompt "Mode of SPI RAM chip"
	default ESP32P4_SPIRAM_MODE_QUAD

config ESP32P4_SPIRAM_MODE_QUAD
	bool "Quad Mode PSRAM"

config ESP32P4_SPIRAM_MODE_OCT
	bool "Octal Mode PSRAM"

config ESP32P4_SPIRAM_MODE_HEX
	bool "HEX DDR Mode PSRAM (16-line)"

endchoice # ESP32P4_SPIRAM_MODE

choice ESP32P4_SPIRAM_SPEED
	prompt "Set RAM clock speed"
	default ESP32P4_SPIRAM_SPEED_80M

config ESP32P4_SPIRAM_SPEED_40M
	bool "40MHz clock speed"

config ESP32P4_SPIRAM_SPEED_80M
	bool "80MHz clock speed"

config ESP32P4_SPIRAM_SPEED_200M
	bool "200MHz clock speed"

config ESP32P4_SPIRAM_SPEED_200M
	bool "200MHz clock speed"

endchoice # ESP32P4_SPIRAM_SPEED

config ESP32P4_SPIRAM_BOOT_INIT
	bool "Initialize SPI RAM during startup"
	default y
	---help---
		If this is enabled, the SPI RAM will be enabled during initial
		boot. Unless you have specific requirements, you'll want to leave
		this enabled so memory allocated during boot-up can also be
		placed in SPI RAM.

config ESP32P4_SPIRAM_MEMTEST
	bool "Run memory test on SPI RAM initialization"
	default y
	depends on ESP32P4_SPIRAM_BOOT_INIT
	---help---
		Runs a rudimentary memory test on initialization. Aborts when
		memory test fails. Disable this for slightly faster startup.

config ESP32P4_SPIRAM_IGNORE_NOTFOUND
	bool "Ignore PSRAM when not found"
	default n
	depends on ESP32P4_SPIRAM_BOOT_INIT
	---help---
		Normally, if PSRAM initialization is enabled during compile time
		but not found at runtime, it is seen as an error making the
		CPU panic. If this is enabled, booting will complete but no
		PSRAM will be available.

config SPIRAM_RODATA
	bool "Cache fetch read-only data from SPI RAM"
	default n
	---help---
		If enabled, rodata in flash will be moved into PSRAM on startup.

config SPIRAM_XIP_FROM_PSRAM
	bool "Execute in place from SPI RAM"
	default n
	---help---
		If enabled, firmware can execute in place from PSRAM.

choice ESP32P4_SPIRAM_SIZE
	prompt "PSRAM size"
	default ESP32P4_PSRAM_32M

config ESP32P4_PSRAM_2M
	bool "2MB"

config ESP32P4_PSRAM_4M
	bool "4MB"

config ESP32P4_PSRAM_8M
	bool "8MB"

config ESP32P4_PSRAM_16M
	bool "16MB"

config ESP32P4_PSRAM_32M
	bool "32MB"

endchoice # ESP32P4_SPIRAM_SIZE

config ESP32P4_SPIRAM_SIZE
	int
	default 2097152 if ESP32P4_PSRAM_2M
	default 4194304 if ESP32P4_PSRAM_4M
	default 8388608 if ESP32P4_PSRAM_8M
	default 16777216 if ESP32P4_PSRAM_16M
	default 33554432 if ESP32P4_PSRAM_32M

endif # ESP32P4_SPIRAM

endmenu # PSRAM Configuration

endif # ARCH_CHIP_ESP32P4

config P4_REV3_MSPI_CRASH_AFTER_POWER_UP_WORKAROUND
	bool
	default y if ESP32P4_REV_MIN_300

config P4_REV3_MSPI_WORKAROUND_SIZE
	hex
	default 0x100 if ESP32P4_REV_MIN_300
	default 0
```
